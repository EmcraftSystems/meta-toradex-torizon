/* Kemaro build: name SMARC GPIO0..GPIO12 and leave them free for userspace.
 * Applied to every lec-mtk1200 build; drop before upstream delivery. */

/* SoC pin controller: SMARC GPIO0..GPIO6.
 * pio60=CAM0_PWR#(GPIO0) pio59=CAM1_PWR#(GPIO1) pio57=CAM0_RST#(GPIO2)
 * pio58=CAM1_RST#(GPIO3) pio118=HDA_RST#(GPIO4) pio72=PWM_OUT(GPIO5)
 * pio119=TACHIN(GPIO6).
 *
 * Names only: the pads are ALT0=GPIO and the controller re-muxes on request.
 * gpio-line-names is positional from offset 0, hence the leading blanks. */
&pio {
	gpio-line-names =
		/*   0.. 9 */ "", "", "", "", "", "", "", "", "", "",
		/*  10..19 */ "", "", "", "", "", "", "", "", "", "",
		/*  20..29 */ "", "", "", "", "", "", "", "", "", "",
		/*  30..39 */ "", "", "", "", "", "", "", "", "", "",
		/*  40..49 */ "", "", "", "", "", "", "", "", "", "",
		/*  50..56 */ "", "", "", "", "", "", "",
		/*  57..60 */ "kemaro-gpio2", "kemaro-gpio3", "kemaro-gpio1", "kemaro-gpio0",
		/*  61..71 */ "", "", "", "", "", "", "", "", "", "", "",
		/*      72 */ "kemaro-gpio5",
		/*  73..79 */ "", "", "", "", "", "", "",
		/*  80..89 */ "", "", "", "", "", "", "", "", "", "",
		/*  90..99 */ "", "", "", "", "", "", "", "", "", "",
		/* 100..109 */ "", "", "", "", "", "", "", "", "", "",
		/* 110..117 */ "", "", "", "", "", "", "", "",
		/*     118 */ "kemaro-gpio4",
		/*     119 */ "kemaro-gpio6";
};

/* On-module SX1509 (U4006): SMARC GPIO7..GPIO12. I/O0 is the header
 * level-shifter enable, output-high at boot - left nameless because driving
 * it from userspace kills the header and nothing re-applies it. */
&gpio0 {
	gpio-line-names =
		/*      0 */ "",
		/*      1 */ "kemaro-gpio7",
		/*      2 */ "kemaro-gpio8",
		/*      3 */ "kemaro-gpio9",
		/*      4 */ "kemaro-gpio10",
		/*  5..12 */ "", "", "", "", "", "", "", "",
		/*     13 */ "kemaro-gpio11",
		/*     14 */ "kemaro-gpio12";
};
